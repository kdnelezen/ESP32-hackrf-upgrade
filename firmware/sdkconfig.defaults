## firmware/sdkconfig.defaults
```kconfig
# ESP32-S3 target (has USB OTG host support)
CONFIG_IDF_TARGET="esp32s3"

# USB Host
CONFIG_USB_HOST_CONTROL_TRANSFER_MAX_SIZE=256
CONFIG_USB_OTG_SUPPORTED=y

# Wi-Fi
CONFIG_ESP_WIFI_STATIC_RX_BUFFER_NUM=10
CONFIG_ESP_WIFI_DYNAMIC_RX_BUFFER_NUM=32
CONFIG_ESP_WIFI_DYNAMIC_TX_BUFFER_NUM=32

# BT – BLE only (saves RAM vs dual mode)
CONFIG_BT_ENABLED=y
CONFIG_BT_BLE_ENABLED=y
CONFIG_BT_CLASSIC_ENABLED=n
CONFIG_BTDM_CTRL_MODE_BLE_ONLY=y

# Console / REPL
CONFIG_ESP_CONSOLE_UART_DEFAULT=y
CONFIG_ESP_CONSOLE_UART_BAUDRATE=115200
CONFIG_LINENOISE_MAX_HISTORY=20
CONFIG_LINENOISE_HISTORY_SAVE=n

# FreeRTOS
CONFIG_FREERTOS_HZ=1000
CONFIG_FREERTOS_ENABLE_STATIC_TASK_CLEAN_UP=n

# Stack sizes
CONFIG_ESP_MAIN_TASK_STACK_SIZE=8192

# Logging
CONFIG_LOG_DEFAULT_LEVEL_INFO=y

# IR GPIO defaults
CONFIG_IR_TX_GPIO=18
CONFIG_IR_RX_GPIO=19

# NVS
CONFIG_NVS_ENCRYPTION=n
```
